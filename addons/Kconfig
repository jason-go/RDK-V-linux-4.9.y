## drivers/misc/nationalchip/gxsecure/drivers/misc_drv/Kconfig
```kconfig
config GX_MISC
	bool "Enable Misc Module"
	default y

if GX_MISC
	config GX_MISC_SCI
		bool "Enable Misc SCI Module"
		default y

	config GX_MISC_OTP
		bool "Enable Misc OTP Module"
		default y

	config GX_MISC_RNG
		bool "Enable Misc RNG Module"
		default y

	config GX_MISC_CHIP_CFG
		bool "Enable Misc Chip config Module"
		default y

	if (CHIP_SIRIUS)
		config GX_MISC_HASH
			bool "Enable Misc Hash Module"
			default y

		config GX_MISC_SM2
			bool "Enable Misc SM2 Module"
			default y
	endif
endif
```

## drivers/misc/nationalchip/gxsecure/drivers/secure_drv/Kconfig
```kconfig
if (CHIP_SIRIUS || CHIP_TAURUS || CHIP_GEMINI)
	config GX_FIRMWARE
		bool "Enable Firmware Module"
		default y

	if GX_FIRMWARE
		config GX_FIRMWARE_MBOX
			bool "Enable Firmware Mailbox Module"
			default y
	endif

		menu "Firmware Module Config:"
			visible if GX_FIRMWARE && GX_FIRMWARE_MBOX

			config MBOX_PROTOCOL_S5H
				bool "Enable Mailbox Protocol S5H"
				default y

			config MBOX_PROTOCOL_GENERIC
				bool "Enable Mailbox Protocol Generic"
				default y

			config MBOX_PROTOCOL_IFCP
				bool "Enable Mailbox Protocol IFCP"
				default y

			config MBOX_SET_DDR_INFO
				bool "Enable Mailbox Set DDR Info"
				default n
		endmenu
endif
```

## drivers/mtd/spinand/Kconfig
```kconfig
#
# linux/drivers/mtd/spinand/Kconfig
#

menuconfig MTD_SPINAND
	tristate "SPINAND Device Support"
	depends on MTD
	help
	  This enables support for accessing Micron SPI NAND flash
	  devices.

if MTD_SPINAND

config SPINAND_DEBUG
	bool "SPINAND debug read/write/erase"
	help
	 debug information

config SPI_NAND_VERIFY_WRITE
	bool "Verify SPI NAND page writes"
	help
	  This adds an extra check when data is written to the flash. The
	  SPI NAND flash device internally checks only bits transitioning
	  from 1 to 0. There is a rare possibility that even though the
	  device thinks the write was successful, a bit could have been
	  flipped accidentally due to device wear or something else.

config MTD_SPINAND_ONDIEECC
	bool "Use SPINAND internal ECC"
	default y
	help
	 Internel ECC

config MTD_SPINAND_SWECC
	bool "Use software ECC"
	depends on MTD_NAND
	help
	 software ECC

endif
```

## drivers/net/nationalchip/Kconfig
```kconfig
menu "Nationalchip drivers"

source drivers/net/nationalchip/nationalchip_eth/Kconfig
endmenu
```
